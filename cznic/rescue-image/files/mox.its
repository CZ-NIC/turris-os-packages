## cznic/rescue-image/files/mox.its
```
/dts-v1/;

/ {
    description = "Rescue image with single Linux kernel and FDT blob";
    #address-cells = <1>;

    images {
        kernel@1 {
            description = "Linux kernel with initramfs included";
            data = /incbin/("./Image");
            type = "kernel_noload";
            arch = "arm64";
            os = "linux";
            compression = "none";
            load =  <0x5000000>;
            entry = <0x5000000>;
            hash@1 {
                algo = "crc32";
            };
            hash@2 {
                algo = "sha1";
            };
        };
        fdt@1 {
            description = "Flattened Device Tree blob";
            data = /incbin/("./dts/marvell/armada-3720-turris-mox.dtb");
            type = "flat_dt";
            arch = "arm64";
            compression = "none";
            hash@1 {
                algo = "crc32";
            };
            hash@2 {
                algo = "sha1";
            };
        };
    };

    configurations {
        default = "conf@1";
        conf@1 {
            description = "Turris MOX rescue image";
            kernel = "kernel@1";
            fdt = "fdt@1";
        };
    };
};
```

## hardware/mox/rescue-image/files/omnia.its
```
/dts-v1/;

/ {
    description = "Rescue image with single Linux kernel and FDT blob";
    #address-cells = <1>;

    images {
        kernel {
            description = "Linux kernel";
            data = /incbin/("./zImage");
            type = "kernel";
            arch = "arm";
            os = "linux";
            compression = "none";
            load =  <0x800000>;
            entry = <0x800000>;
            hash@1 {
                algo = "crc32";
            };
            hash@2 {
                algo = "sha1";
            };
        };
        ramdisk {
            description = "Initial Ramdisk";
            data = /incbin/("./initrd");
            type = "ramdisk";
            arch = "arm";
            os = "linux";
            compression = "none";
            hash@1 {
                algo = "crc32";
            };
            hash@2 {
                algo = "sha1";
            };
        };
        phy-dtb {
            description = "Flattened Device Tree blob (metalic WAN)";
            data = /incbin/("./dts/armada-385-turris-omnia-phy.dtb");
            type = "flat_dt";
            arch = "arm";
            compression = "none";
            hash@1 {
                algo = "crc32";
            };
            hash@2 {
                algo = "sha1";
            };
        };
        sfp-dtb {
            description = "Flattened Device Tree blob (SFP WAN)";
            data = /incbin/("./dts/armada-385-turris-omnia-sfp.dtb");
            type = "flat_dt";
            arch = "arm";
            compression = "none";
            hash@1 {
                algo = "crc32";
            };
            hash@2 {
                algo = "sha1";
            };
        };
    };

    configurations {
        default = "def";
        def {
            description = "Turris Omnia rescue image";
            kernel = "kernel";
            ramdisk = "ramdisk";
            fdt = "phy-dtb";
        };
        sfp {
            description = "Turris Omnia rescue image (SFP)";
            kernel = "kernel";
            ramdisk = "ramdisk";
            fdt = "sfp-dtb";
        };
    };
};
```

## net/knot-resolver/Config.in
```kconfig
menu "Configuration"

config KNOT_RESOLVER_DYNAMIC_DOMAINS
	bool "Enable dynamic domains dependency"
	help
		Add dependency for dynamic domains
	default y

endmenu
```

## net/unbound/Config.in
```kconfig
menu "Configuration"

config UNBOUND_DYNAMIC_DOMAINS
	bool "Enable dynamic domains dependency"
	help
	Add dependency for dynamic domains
	default y

endmenu
```

## sound/cmus/Config.in
```kconfig
menu "Configuration"
	depends on PACKAGE_cmus

config CMUS_WITH_PULSE
	bool "Enable pulseaudio support"
	default n

config CONFIG_CMUS_WITH_OSS
	bool "Enable OSS support"
	default n

endmenu
```

## utils/squashfs-tools/Config.in
```kconfig
if PACKAGE_squashfs-tools-mksquashfs || PACKAGE_squashfs-tools-unsquashfs

config SQUASHFS_TOOLS_LZO_SUPPORT
	bool "Enable LZO support"
	default y

config SQUASHFS_TOOLS_XZ_SUPPORT
	bool "Enable XZ support"
	default y

endif
```

## utils/turris-netboot/files/mox.its
```
/dts-v1/;

/ {
    description = "Netboot image with single Linux kernel and FDT blob";
    #address-cells = <1>;

    images {
        kernel-0 {
            description = "Linux kernel without";
            data = /incbin/("./boot/Image");
            type = "kernel_noload";
            arch = "arm64";
            os = "linux";
            compression = "none";
            load =  <0x5000000>;
            entry = <0x5000000>;
            hash-1 {
                algo = "crc32";
            };
            hash-2 {
                algo = "sha1";
            };
        };
        ramdisk-0 {
            description = "initramfs";
            data = /incbin/("./usr/share/turris-netboot/initrd-aarch64");
            type = "ramdisk";
            arch = "arm64";
            os = "linux";
            compression = "none";
            hash-1 {
                algo = "crc32";
            };
            hash-2 {
                algo = "sha1";
            };
        };
        fdt-0 {
            description = "Flattened Device Tree blob";
            data = /incbin/("./boot/armada-3720-turris-mox.dtb");
            type = "flat_dt";
            arch = "arm64";
            compression = "none";
            hash-1 {
                algo = "crc32";
            };
            hash-2 {
                algo = "sha1";
            };
        };
    };

    configurations {
        default = "conf-1";
        conf-1 {
            description = "Turris MOX netboot image";
            kernel = "kernel-0";
            ramdisk = "ramdisk-0";
            fdt = "fdt-0";
        };
    };
};
```
